/* display.c */
#include <string.h>
#include <stdarg.h>
#include <stdio.h>
#include "driver/gpio.h"
#include "driver/i2c.h"
#include "freertos/FreeRTOS.h"
#include "freertos/task.h"
#include "esp_log.h"
#include "display.h"

#define PIN_SDA 17
#define PIN_SCL 18
#define PIN_RST 21
#define PIN_VEXT 36
#define OLED_ADDR 0x3C
#define W 128
#define H 64

static const char *TAG = "oled";
static uint8_t fb[W * H / 8];

typedef struct { char c; uint8_t col[5]; } glyph_t;
static const glyph_t FONT[] = {
  { ' ', {0x00, 0x00, 0x00, 0x00, 0x00} }, { '.', {0x00, 0x60, 0x60, 0x00, 0x00} },
  { ':', {0x00, 0x36, 0x36, 0x00, 0x00} }, { '/', {0x20, 0x10, 0x08, 0x04, 0x02} },
  { '+', {0x08, 0x08, 0x3E, 0x08, 0x08} }, { '-', {0x08, 0x08, 0x08, 0x08, 0x08} },
  { '_', {0x40, 0x40, 0x40, 0x40, 0x40} }, { '%', {0x23, 0x13, 0x08, 0x64, 0x62} },
  { '0', {0x3E, 0x51, 0x49, 0x45, 0x3E} }, { '1', {0x00, 0x42, 0x7F, 0x40, 0x00} },
  { '2', {0x42, 0x61, 0x51, 0x49, 0x46} }, { '3', {0x21, 0x41, 0x45, 0x4B, 0x31} },
  { '4', {0x18, 0x14, 0x12, 0x7F, 0x10} }, { '5', {0x27, 0x45, 0x45, 0x45, 0x39} },
  { '6', {0x3C, 0x4A, 0x49, 0x49, 0x30} }, { '7', {0x01, 0x71, 0x09, 0x05, 0x03} },
  { '8', {0x36, 0x49, 0x49, 0x49, 0x36} }, { '9', {0x06, 0x49, 0x49, 0x29, 0x1E} },
  { 'A', {0x7E, 0x11, 0x11, 0x11, 0x7E} }, { 'B', {0x7F, 0x49, 0x49, 0x49, 0x36} },
  { 'C', {0x3E, 0x41, 0x41, 0x41, 0x22} }, { 'D', {0x7F, 0x41, 0x41, 0x22, 0x1C} },
  { 'E', {0x7F, 0x49, 0x49, 0x49, 0x41} }, { 'F', {0x7F, 0x09, 0x09, 0x09, 0x01} },
  { 'G', {0x3E, 0x41, 0x49, 0x49, 0x7A} }, { 'H', {0x7F, 0x08, 0x08, 0x08, 0x7F} },
  { 'I', {0x00, 0x41, 0x7F, 0x41, 0x00} }, { 'J', {0x20, 0x40, 0x41, 0x3F, 0x01} },
  { 'K', {0x7F, 0x08, 0x14, 0x22, 0x41} }, { 'L', {0x7F, 0x40, 0x40, 0x40, 0x40} },
  { 'M', {0x7F, 0x02, 0x0C, 0x02, 0x7F} }, { 'N', {0x7F, 0x04, 0x08, 0x10, 0x7F} },
  { 'O', {0x3E, 0x41, 0x41, 0x41, 0x3E} }, { 'P', {0x7F, 0x09, 0x09, 0x09, 0x06} },
  { 'Q', {0x3E, 0x41, 0x51, 0x21, 0x5E} }, { 'R', {0x7F, 0x09, 0x19, 0x29, 0x46} },
  { 'S', {0x26, 0x49, 0x49, 0x49, 0x32} }, { 'T', {0x01, 0x01, 0x7F, 0x01, 0x01} },
  { 'U', {0x3F, 0x40, 0x40, 0x40, 0x3F} }, { 'V', {0x1F, 0x20, 0x40, 0x20, 0x1F} },
  { 'W', {0x3F, 0x40, 0x30, 0x40, 0x3F} }, { 'X', {0x41, 0x22, 0x1C, 0x22, 0x41} },
  { 'Y', {0x01, 0x02, 0x7C, 0x02, 0x01} }, { 'Z', {0x61, 0x51, 0x49, 0x45, 0x43} },
  { 'a', {0x20, 0x54, 0x54, 0x54, 0x78} }, { 'b', {0x7F, 0x44, 0x44, 0x44, 0x38} },
  { 'c', {0x38, 0x44, 0x44, 0x44, 0x20} }, { 'd', {0x38, 0x44, 0x44, 0x48, 0x7F} },
  { 'e', {0x38, 0x54, 0x54, 0x54, 0x18} }, { 'f', {0x08, 0x7E, 0x09, 0x01, 0x02} },
  { 'g', {0x0C, 0x52, 0x52, 0x52, 0x3E} }, { 'h', {0x7F, 0x08, 0x04, 0x04, 0x78} },
  { 'i', {0x00, 0x44, 0x7D, 0x40, 0x00} }, { 'j', {0x20, 0x40, 0x44, 0x3D, 0x00} },
  { 'k', {0x7F, 0x10, 0x28, 0x44, 0x00} }, { 'l', {0x00, 0x41, 0x7F, 0x40, 0x00} },
  { 'm', {0x7C, 0x04, 0x18, 0x04, 0x78} }, { 'n', {0x7C, 0x08, 0x04, 0x04, 0x78} },
  { 'o', {0x38, 0x44, 0x44, 0x44, 0x38} }, { 'p', {0x7C, 0x14, 0x14, 0x14, 0x08} },
  { 'q', {0x08, 0x14, 0x14, 0x18, 0x7C} }, { 'r', {0x7C, 0x08, 0x04, 0x04, 0x08} },
  { 's', {0x48, 0x54, 0x54, 0x54, 0x24} }, { 't', {0x04, 0x3F, 0x44, 0x40, 0x20} },
  { 'u', {0x3C, 0x40, 0x40, 0x20, 0x7C} }, { 'v', {0x1C, 0x20, 0x40, 0x20, 0x1C} },
  { 'w', {0x3C, 0x40, 0x30, 0x40, 0x3C} }, { 'x', {0x44, 0x28, 0x10, 0x28, 0x44} },
  { 'y', {0x0C, 0x50, 0x50, 0x50, 0x3C} }, { 'z', {0x44, 0x64, 0x54, 0x4C, 0x44} },
};

static const uint8_t *glyph(char c) {
  for (size_t i = 0; i < sizeof FONT / sizeof FONT[0]; i++)
    if (FONT[i].c == c) return FONT[i].col;
  return NULL;
}

static esp_err_t oled_write(uint8_t control, const uint8_t *d, size_t n) {
  uint8_t buf[1 + W];
  buf[0] = control;
  memcpy(buf + 1, d, n);
  return i2c_master_write_to_device(I2C_NUM_0, OLED_ADDR, buf, n + 1, pdMS_TO_TICKS(100));
}

static void put_px(int x, int y) {
  if (x < 0 || x >= W || y < 0 || y >= H) return;
  fb[x + (y >> 3) * W] |= 1u << (y & 7);
}

static void draw_char(int x, int y, char ch, int s) {
  const uint8_t *g = glyph(ch);
  if (!g) return;
  for (int c = 0; c < 5; c++)
    for (int r = 0; r < 7; r++)
      if ((g[c] >> r) & 1)
        for (int dx = 0; dx < s; dx++)
          for (int dy = 0; dy < s; dy++)
            put_px(x + c * s + dx, y + r * s + dy);
}

static void flush_fb(void) {
  static const uint8_t addr[] = { 0x21, 0, W - 1, 0x22, 0, 7 };
  oled_write(0x00, addr, sizeof addr);
  for (int p = 0; p < 8; p++) oled_write(0x40, &fb[p * W], W);
}

void display_init(void) {
  gpio_reset_pin(PIN_VEXT);
  gpio_set_direction(PIN_VEXT, GPIO_MODE_OUTPUT);
  gpio_set_level(PIN_VEXT, 0);
  vTaskDelay(pdMS_TO_TICKS(50));

  gpio_reset_pin(PIN_RST);
  gpio_set_direction(PIN_RST, GPIO_MODE_OUTPUT);
  gpio_set_level(PIN_RST, 0);
  vTaskDelay(pdMS_TO_TICKS(20));
  gpio_set_level(PIN_RST, 1);
  vTaskDelay(pdMS_TO_TICKS(20));

  i2c_config_t cfg = {
    .mode = I2C_MODE_MASTER,
    .sda_io_num = PIN_SDA, .scl_io_num = PIN_SCL,
    .sda_pullup_en = GPIO_PULLUP_ENABLE, .scl_pullup_en = GPIO_PULLUP_ENABLE,
    .master.clk_speed = 400000,
  };
  ESP_ERROR_CHECK(i2c_param_config(I2C_NUM_0, &cfg));
  ESP_ERROR_CHECK(i2c_driver_install(I2C_NUM_0, I2C_MODE_MASTER, 0, 0, 0));

  static const uint8_t init[] = {
    0xAE, 0xD5, 0x80, 0xA8, 0x3F, 0xD3, 0x00, 0x40,
    0x8D, 0x14, 0x20, 0x00, 0xA1, 0xC8, 0xDA, 0x12,
    0x81, 0xCF, 0xD9, 0xF1, 0xDB, 0x40, 0xA4, 0xA6, 0xAF,
  };
  if (oled_write(0x00, init, sizeof init) != ESP_OK)
    ESP_LOGE(TAG, "el OLED no responde en 0x%02X (revisa SDA/SCL/Vext)", OLED_ADDR);
}

void display_clear(void) {
  memset(fb, 0, sizeof fb);
}

void display_printf(int line, const char *fmt, ...) {
  char buf[22];
  va_list ap;
  va_start(ap, fmt);
  vsnprintf(buf, sizeof buf, fmt, ap);
  va_end(ap);

  int x = 0;
  for(const char *p = buf; *p; p++, x += 6) draw_char(x, line * 8, *p, 1);
}

void display_flush(void) {
  flush_fb();
}